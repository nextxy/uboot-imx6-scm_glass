## arch/arm/Kconfig
```kconfig
menu "ARM architecture"
	depends on ARM

config SYS_ARCH
	default "arm"

config ARM64
	bool

config HAS_VBAR
        bool

config CPU_ARM720T
        bool

config CPU_ARM920T
        bool

config CPU_ARM926EJS
        bool

config CPU_ARM946ES
        bool

config CPU_ARM1136
        bool

config CPU_ARM1176
        bool
        select HAS_VBAR

config CPU_V7
        bool
        select HAS_VBAR

config CPU_PXA
        bool

config CPU_SA1100
        bool

config SYS_CPU
        default "arm720t" if CPU_ARM720T
        default "arm920t" if CPU_ARM920T
        default "arm926ejs" if CPU_ARM926EJS
        default "arm946es" if CPU_ARM946ES
        default "arm1136" if CPU_ARM1136
        default "arm1176" if CPU_ARM1176
        default "armv7" if CPU_V7
        default "pxa" if CPU_PXA
        default "sa1100" if CPU_SA1100
	default "armv8" if ARM64

config SEMIHOSTING
	bool "support boot from semihosting"
	help
	  In emulated environments, semihosting is a way for
	  the hosted environment to call out to the emulator to
	  retrieve files from the host machine.

choice
	prompt "Target select"

config TARGET_INTEGRATORAP_CM720T
	bool "Support integratorap_cm720t"
	select CPU_ARM720T

config TARGET_INTEGRATORAP_CM920T
	bool "Support integratorap_cm920t"
	select CPU_ARM920T

config TARGET_INTEGRATORCP_CM920T
	bool "Support integratorcp_cm920t"
	select CPU_ARM920T

config ARCH_AT91
	bool "Atmel AT91"

config TARGET_EDB93XX
	bool "Support edb93xx"
	select CPU_ARM920T

config TARGET_SCB9328
	bool "Support scb9328"
	select CPU_ARM920T

config TARGET_VCMA9
	bool "Support VCMA9"
	select CPU_ARM920T

config TARGET_SMDK2410
	bool "Support smdk2410"
	select CPU_ARM920T

config TARGET_INTEGRATORAP_CM926EJS
	bool "Support integratorap_cm926ejs"
	select CPU_ARM926EJS

config TARGET_INTEGRATORCP_CM926EJS
	bool "Support integratorcp_cm926ejs"
	select CPU_ARM926EJS

config TARGET_ASPENITE
	bool "Support aspenite"
	select CPU_ARM926EJS

config TARGET_GPLUGD
	bool "Support gplugd"
	select CPU_ARM926EJS

config ARCH_DAVINCI
	bool "TI DaVinci"
	select CPU_ARM926EJS
	help
	  Support for TI's DaVinci platform.

config KIRKWOOD
	bool "Marvell Kirkwood"
	select CPU_ARM926EJS

config TARGET_DB_MV784MP_GP
	bool "Support db-mv784mp-gp"
	select CPU_V7
	select SUPPORT_SPL

config TARGET_MAXBCM
	bool "Support maxbcm"
	select CPU_V7
	select SUPPORT_SPL

config TARGET_DEVKIT3250
	bool "Support devkit3250"
	select CPU_ARM926EJS

config TARGET_WORK_92105
	bool "Support work_92105"
	select CPU_ARM926EJS
	select SUPPORT_SPL

config TARGET_MX25PDK
	bool "Support mx25pdk"
	select CPU_ARM926EJS

config TARGET_TX25
	bool "Support tx25"
	select CPU_ARM926EJS
	select SUPPORT_SPL

config TARGET_ZMX25
	bool "Support zmx25"
	select CPU_ARM926EJS

config TARGET_APF27
	bool "Support apf27"
	select CPU_ARM926EJS
	select SUPPORT_SPL

config TARGET_IMX27LITE
	bool "Support imx27lite"
	select CPU_ARM926EJS

config TARGET_MAGNESIUM
	bool "Support magnesium"
	select CPU_ARM926EJS

config TARGET_APX4DEVKIT
	bool "Support apx4devkit"
	select CPU_ARM926EJS
	select SUPPORT_SPL

config TARGET_XFI3
	bool "Support xfi3"
	select CPU_ARM926EJS
	select SUPPORT_SPL

config TARGET_M28EVK
	bool "Support m28evk"
	select CPU_ARM926EJS
	select SUPPORT_SPL

config TARGET_MX23EVK
	bool "Support mx23evk"
	select CPU_ARM926EJS
	select SUPPORT_SPL

config TARGET_MX28EVK
	bool "Support mx28evk"
	select CPU_ARM926EJS
	select SUPPORT_SPL

config TARGET_MX23_OLINUXINO
	bool "Support mx23_olinuxino"
	select CPU_ARM926EJS
	select SUPPORT_SPL

config TARGET_BG0900
	bool "Support bg0900"
	select CPU_ARM926EJS
	select SUPPORT_SPL

config TARGET_SANSA_FUZE_PLUS
	bool "Support sansa_fuze_plus"
	select CPU_ARM926EJS
	select SUPPORT_SPL

config TARGET_SC_SPS_1
	bool "Support sc_sps_1"
	select CPU_ARM926EJS
	select SUPPORT_SPL

config ARCH_NOMADIK
	bool "ST-Ericsson Nomadik"
	select CPU_ARM926EJS

config ORION5X
	bool "Marvell Orion"
	select CPU_ARM926EJS

config TARGET_SPEAR300
	bool "Support spear300"
	select CPU_ARM926EJS

config TARGET_SPEAR310
	bool "Support spear310"
	select CPU_ARM926EJS

config TARGET_SPEAR320
	bool "Support spear320"
	select CPU_ARM926EJS

config TARGET_SPEAR600
	bool "Support spear600"
	select CPU_ARM926EJS

config TARGET_STV0991
	bool "Support stv0991"
	select CPU_V7

config TARGET_X600
	bool "Support x600"
	select CPU_ARM926EJS
	select SUPPORT_SPL

config ARCH_VERSATILE
	bool "ARM Ltd. Versatile family"
	select CPU_ARM926EJS

config TARGET_INTEGRATORCP_CM1136
	bool "Support integratorcp_cm1136"
	select CPU_ARM1136

config TARGET_IMX31_PHYCORE
	bool "Support imx31_phycore"
	select CPU_ARM1136

config TARGET_QONG
	bool "Support qong"
	select CPU_ARM1136

config TARGET_MX31ADS
	bool "Support mx31ads"
	select CPU_ARM1136

config TARGET_MX31PDK
	bool "Support mx31pdk"
	select CPU_ARM1136
	select SUPPORT_SPL

config TARGET_TT01
	bool "Support tt01"
	select CPU_ARM1136

config TARGET_IMX31_LITEKIT
	bool "Support imx31_litekit"
	select CPU_ARM1136

config TARGET_WOODBURN
	bool "Support woodburn"
	select CPU_ARM1136

config TARGET_WOODBURN_SD
	bool "Support woodburn_sd"
	select CPU_ARM1136
	select SUPPORT_SPL

config TARGET_FLEA3
	bool "Support flea3"
	select CPU_ARM1136

config TARGET_MX35PDK
	bool "Support mx35pdk"
	select CPU_ARM1136

config ARCH_BCM283X
	bool "Broadcom BCM283X family"

config TARGET_INTEGRATORAP_CM946ES
	bool "Support integratorap_cm946es"
	select CPU_ARM946ES

config TARGET_INTEGRATORCP_CM946ES
	bool "Support integratorcp_cm946es"
	select CPU_ARM946ES

config TARGET_VEXPRESS_CA15_TC2
	bool "Support vexpress_ca15_tc2"
	select CPU_V7
	select CPU_V7_HAS_NONSEC
	select CPU_V7_HAS_VIRT

config TARGET_VEXPRESS_CA5X2
	bool "Support vexpress_ca5x2"
	select CPU_V7

config TARGET_VEXPRESS_CA9X4
	bool "Support vexpress_ca9x4"
	select CPU_V7

config TARGET_KWB
	bool "Support kwb"
	select CPU_V7
	select SUPPORT_SPL

config TARGET_TSERIES
	bool "Support tseries"
	select CPU_V7
	select SUPPORT_SPL

config TARGET_CM_T335
	bool "Support cm_t335"
	select CPU_V7
	select SUPPORT_SPL

config TARGET_PEPPER
	bool "Support pepper"
	select CPU_V7
	select SUPPORT_SPL

config TARGET_AM335X_IGEP0033
	bool "Support am335x_igep0033"
	select CPU_V7
	select SUPPORT_SPL

config TARGET_PCM051
	bool "Support pcm051"
	select CPU_V7
	select SUPPORT_SPL

config TARGET_DRACO
	bool "Support draco"
	select CPU_V7
	select SUPPORT_SPL

config TARGET_DXR2
	bool "Support dxr2"
	select CPU_V7
	select SUPPORT_SPL

config TARGET_PXM2
	bool "Support pxm2"
	select CPU_V7
	select SUPPORT_SPL

config TARGET_RUT
	bool "Support rut"
	select CPU_V7
	select SUPPORT_SPL

config TARGET_PENGWYN
	bool "Support pengwyn"
	select CPU_V7
	select SUPPORT_SPL

config TARGET_AM335X_EVM
	bool "Support am335x_evm"
	select CPU_V7
	select SUPPORT_SPL

config TARGET_AM43XX_EVM
	bool "Support am43xx_evm"
	select CPU_V7
	select SUPPORT_SPL

config TARGET_BAV335X
	bool "Support bav335x"
	select CPU_V7
	select SUPPORT_SPL
	help
	  The BAV335x OEM Network Processor integrates all the functions of an
	  embedded network computer in a small, easy to use SODIMM module which
	  incorporates the popular Texas Instruments Sitara 32bit ARM Coretex-A8
	  processor, with fast DDR3 512MB SDRAM, 4GB of embedded MMC and a Gigabit
	  ethernet with simple connection to external connectors.

	  For more information, visit: http://birdland.com/oem

config TARGET_TI814X_EVM
	bool "Support ti814x_evm"
	select CPU_V7
	select SUPPORT_SPL

config TARGET_TI816X_EVM
	bool "Support ti816x_evm"
	select CPU_V7
	select SUPPORT_SPL

config TARGET_BCM28155_AP
	bool "Support bcm28155_ap"
	select CPU_V7

config TARGET_BCMCYGNUS
	bool "Support bcmcygnus"
	select CPU_V7

config TARGET_BCMNSP
	bool "Support bcmnsp"
	select CPU_V7

config ARCH_EXYNOS
	bool "Samsung EXYNOS"
	select CPU_V7

config ARCH_S5PC1XX
	bool "Samsung S5PC1XX"
	select CPU_V7

config ARCH_HIGHBANK
	bool "Calxeda Highbank"
	select CPU_V7

config ARCH_KEYSTONE
	bool "TI Keystone"
	select CPU_V7
	select SUPPORT_SPL

config ARCH_MX6
	bool "Freescale MX6"
	select CPU_V7

config ARCH_MX5
	bool "Freescale MX5"
	select CPU_V7

config TARGET_M53EVK
	bool "Support m53evk"
	select CPU_V7
	select SUPPORT_SPL

config TARGET_IMA3_MX53
	bool "Support ima3-mx53"
	select CPU_V7

config TARGET_MX51EVK
	bool "Support mx51evk"
	select CPU_V7

config TARGET_MX53ARD
	bool "Support mx53ard"
	select CPU_V7

config TARGET_MX53EVK
	bool "Support mx53evk"
	select CPU_V7

config TARGET_MX53LOCO
	bool "Support mx53loco"
	select CPU_V7

config TARGET_MX53SMD
	bool "Support mx53smd"
	select CPU_V7

config TARGET_MX51_EFIKAMX
	bool "Support mx51_efikamx"
	select CPU_V7

config TARGET_VISION2
	bool "Support vision2"
	select CPU_V7

config TARGET_UDOO
	bool "Support udoo"
	select CPU_V7

config TARGET_WANDBOARD
	bool "Support wandboard"
	select CPU_V7

config TARGET_WARP
	bool "Support WaRP"
	select CPU_V7

config TARGET_TITANIUM
	bool "Support titanium"
	select CPU_V7

config TARGET_NITROGEN6X
	bool "Support nitrogen6x"
	select CPU_V7

config TARGET_CGTQMX6EVAL
	bool "Support cgtqmx6eval"
	select CPU_V7

config TARGET_EMBESTMX6BOARDS
	bool "Support embestmx6boards"
	select CPU_V7

config TARGET_ARISTAINETOS
	bool "Support aristainetos"
	select CPU_V7

config TARGET_MX6QARM2
	bool "Support mx6qarm2"
	select CPU_V7

config TARGET_MX6QSABREAUTO
	bool "Support mx6qsabreauto"
	select CPU_V7

config TARGET_MX6SABRESD
	bool "Support mx6sabresd"
	select CPU_V7
	select SUPPORT_SPL

config TARGET_MX6DQSCMQWKS
	bool "Support mx6dqscmqwks"
	select CPU_V7
	select SUPPORT_SPL

config TARGET_MX6SLEVK
	bool "Support mx6slevk"
	select CPU_V7

config TARGET_MX6SXSABRESD
	bool "Support mx6sxsabresd"
	select CPU_V7
	select SUPPORT_SPL

config TARGET_MX6SXSABREAUTO
	bool "Support mx6sxsabreauto"
	select CPU_V7

config TARGET_MX6SX_17X17_ARM2
	bool "Support mx6sx_17x17_arm2"
	select CPU_V7

config TARGET_MX6SX_19X19_ARM2
	bool "Support mx6sx_19x19_arm2"
	select CPU_V7

config TARGET_MX7D_12X12_LPDDR3_ARM2
	bool "Support mx7d_12x12_lpddr3_arm2"
	select CPU_V7

config TARGET_MX7D_12X12_DDR3_ARM2
	bool "Support mx7d_12x12_ddr3_arm2"
	select CPU_V7

config TARGET_MX7D_19X19_LPDDR3_ARM2
	bool "Support mx7d_19x19_lpddr3_arm2"
	select CPU_V7

config TARGET_MX7D_19X19_DDR3_ARM2
	bool "Support mx7d_19x19_ddr3_arm2"
	select CPU_V7

config TARGET_MX7DSABRESD
	bool "Support mx7dsabresd"
	select CPU_V7

config TARGET_MX6UL_14X14_EVK
        bool "Support mx6ul_14x14_evk"
        select CPU_V7

config TARGET_MX6UL_14X14_DDR3_ARM2
	bool "Support mx6ul_14x14_ddr3_arm2"
	select CPU_V7

config TARGET_MX6UL_14X14_LPDDR2_ARM2
        bool "Support mx6ul_14x14_lpddr2_arm2"
        select CPU_V7

config TARGET_GW_VENTANA
	bool "Support gw_ventana"
	select CPU_V7
	select SUPPORT_SPL

config TARGET_HUMMINGBOARD
	bool "Support hummingboard"
	select CPU_V7

config TARGET_KOSAGI_NOVENA
	bool "Support Kosagi Novena"
	select CPU_V7
	select SUPPORT_SPL

config TARGET_TBS2910
	bool "Support tbs2910"
	select CPU_V7

config TARGET_TQMA6
	bool "TQ Systems TQMa6 board"
	select CPU_V7

config TARGET_OT1200
	bool "Bachmann OT1200"
	select CPU_V7
	select SUPPORT_SPL

config TARGET_PLATINUM_PICON
	bool "Support platinum-picon"
	select CPU_V7
	select SUPPORT_SPL

config TARGET_PLATINUM_TITANIUM
	bool "Support platinum-titanium"
	select CPU_V7
	select SUPPORT_SPL

config OMAP34XX
	bool "OMAP34XX SoC"
	select CPU_V7

config OMAP44XX
	bool "OMAP44XX SoC"
	select CPU_V7
	select SUPPORT_SPL

config OMAP54XX
	bool "OMAP54XX SoC"
	select CPU_V7
	select SUPPORT_SPL

config RMOBILE
	bool "Renesas ARM SoCs"
	select CPU_V7

config TARGET_CM_FX6
	bool "Support cm_fx6"
	select CPU_V7
	select SUPPORT_SPL

config TARGET_SOCFPGA_ARRIA5
	bool "Support socfpga_arria5"
	select CPU_V7
	select SUPPORT_SPL

config TARGET_SOCFPGA_CYCLONE5
	bool "Support socfpga_cyclone5"
	select CPU_V7
	select SUPPORT_SPL

config ARCH_SUNXI
	bool "Support sunxi (Allwinner) SoCs"

config TARGET_SNOWBALL
	bool "Support snowball"
	select CPU_V7

config TARGET_U8500_HREF
	bool "Support u8500_href"
	select CPU_V7

config TARGET_VF610TWR
	bool "Support vf610twr"
	select CPU_V7

config ZYNQ
	bool "Xilinx Zynq Platform"
	select CPU_V7
	select SUPPORT_SPL

config TARGET_XILINX_ZYNQMP
	bool "Support Xilinx ZynqMP Platform"
	select ARM64

config TEGRA
	bool "NVIDIA Tegra"
	select SUPPORT_SPL
	select SPL
	select OF_CONTROL
	select CPU_V7

config TARGET_VEXPRESS64_AEMV8A
	bool "Support vexpress_aemv8a"
	select ARM64

config TARGET_VEXPRESS64_BASE_FVP
	bool "Support Versatile Express ARMv8a FVP BASE model"
	select ARM64
	select SEMIHOSTING

config TARGET_VEXPRESS64_JUNO
	bool "Support Versatile Express Juno Development Platform"
	select ARM64

config TARGET_LS2085A_EMU
	bool "Support ls2085a_emu"
	select ARM64
	select ARMV8_MULTIENTRY

config TARGET_LS2085A_SIMU
	bool "Support ls2085a_simu"
	select ARM64
	select ARMV8_MULTIENTRY

config TARGET_LS1021AQDS
	bool "Support ls1021aqds"
	select CPU_V7
	select SUPPORT_SPL

config TARGET_LS1021ATWR
	bool "Support ls1021atwr"
	select CPU_V7
	select SUPPORT_SPL

config TARGET_BALLOON3
	bool "Support balloon3"
	select CPU_PXA

config TARGET_H2200
	bool "Support h2200"
	select CPU_PXA

config TARGET_PALMLD
	bool "Support palmld"
	select CPU_PXA

config TARGET_PALMTC
	bool "Support palmtc"
	select CPU_PXA

config TARGET_PALMTREO680
	bool "Support palmtreo680"
	select CPU_PXA
	select SUPPORT_SPL

config TARGET_PXA255_IDP
	bool "Support pxa255_idp"
	select CPU_PXA

config TARGET_TRIZEPSIV
	bool "Support trizepsiv"
	select CPU_PXA

config TARGET_VPAC270
	bool "Support vpac270"
	select CPU_PXA
	select SUPPORT_SPL

config TARGET_XAENIAX
	bool "Support xaeniax"
	select CPU_PXA

config TARGET_ZIPITZ2
	bool "Support zipitz2"
	select CPU_PXA

config TARGET_LP8X4X
	bool "Support lp8x4x"
	select CPU_PXA

config TARGET_COLIBRI_PXA270
	bool "Support colibri_pxa270"
	select CPU_PXA

config TARGET_JORNADA
	bool "Support jornada"
	select CPU_SA1100

config ARCH_UNIPHIER
	bool "Panasonic UniPhier platform"
	select CPU_V7
	select SUPPORT_SPL
	select SPL
	select OF_CONTROL

endchoice

source "arch/arm/cpu/armv7/mx6/Kconfig"

source "arch/arm/cpu/armv7/Kconfig"

source "arch/arm/imx-common/Kconfig"

source "board/freescale/mx6dqscmqwks/Kconfig"



source "arch/arm/Kconfig.debug"

endmenu
```

## board/freescale/mx6dqscmqwks/Kconfig
```kconfig
if TARGET_MX6DQSCMQWKS

config SYS_BOARD
	default "mx6dqscmqwks"

config SYS_VENDOR
	default "freescale"

config SYS_SOC
	default "mx6"

config SYS_CONFIG_NAME
	default "mx6dqscmqwks"

endif
```

## configs/mx6dqscm_1gb_fix_qwks_rev1_defconfig
```kconfig
CONFIG_SYS_EXTRA_OPTIONS="IMX_CONFIG=board/freescale/mx6dqscmqwks/imximage_scm_lpddr2.cfg,MX6Q,DDR_MB=1024,SYS_USE_SPINOR,DEFAULT_FDT_FILE=\"imx6dqscm-1gb-qwks-rev1-fix-ldo.dtb\""
CONFIG_ARM=y
CONFIG_TARGET_MX6DQSCMQWKS=y
CONFIG_DM=y
CONFIG_DM_THERMAL=y
```

## configs/mx6dqscm_1gb_interleaving_qwks_rev2_spinor_defconfig
```kconfig
CONFIG_SYS_EXTRA_OPTIONS="IMX_CONFIG=board/freescale/mx6dqscmqwks/imximage_scm_lpddr2.cfg,MX6Q,DDR_MB=1024,SYS_BOOT_SPINOR,DEFAULT_FDT_FILE=\"imx6dqscm-1gb-qwks-rev2-interleave-ldo.dtb\",INTERLEAVING_MODE"
CONFIG_ARM=y
CONFIG_TARGET_MX6DQSCMQWKS=y
CONFIG_SYS_MALLOC_F=y
CONFIG_SYS_MALLOC_F_LEN=0x400
CONFIG_DM=y
CONFIG_DM_THERMAL=y
```

## configs/mx6dqscm_2gb_fix_hvb_defconfig
```kconfig
CONFIG_SYS_EXTRA_OPTIONS="IMX_CONFIG=board/freescale/mx6dqscmqwks/imximage_scm_lpddr2.cfg,MX6Q,DDR_MB=2048,SYS_USE_SPINOR,DEFAULT_FDT_FILE=\"imx6dqscm-1gb-hvb-fix-ldo.dtb\",SCMHVB,SCM_LPDDR2_2GB"
CONFIG_ARM=y
CONFIG_TARGET_MX6DQSCMQWKS=y
CONFIG_DM=y
CONFIG_DM_THERMAL=y
```

## configs/mx6dqscm_2gb_interleaving_evb_spinor_defconfig
```kconfig
CONFIG_SYS_EXTRA_OPTIONS="IMX_CONFIG=board/freescale/mx6dqscmqwks/imximage_scm_lpddr2.cfg,MX6Q,DDR_MB=2048,SYS_BOOT_SPINOR,DEFAULT_FDT_FILE=\"imx6dqscm-2gb-evb-interleave-ldo.dtb\",INTERLEAVING_MODE,SCMEVB,SCM_LPDDR2_2GB"
CONFIG_ARM=y
CONFIG_TARGET_MX6DQSCMQWKS=y
CONFIG_SYS_MALLOC_F=y
CONFIG_SYS_MALLOC_F_LEN=0x400
CONFIG_DM=y
CONFIG_DM_THERMAL=y
```
