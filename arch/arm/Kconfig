## configs/mx6dqscm_512mb_hvb_defconfig
```kconfig
CONFIG_SYS_EXTRA_OPTIONS="IMX_CONFIG=board/freescale/mx6dqscmqwks/imximage_scm_lpddr2.cfg,MX6Q,DDR_MB=512,SYS_USE_SPINOR,DEFAULT_FDT_FILE=\"imx6dqscm-512mb-hvb-fix-ldo.dtb\",SCMHVB,SCM_LPDDR2_512MB"
CONFIG_ARM=y
CONFIG_TARGET_MX6DQSCMQWKS=y
CONFIG_DM=y
CONFIG_DM_THERMAL=y
```
